/*
 * Copyright (c) 2020 Nordic Semiconductor ASA
 *
 * SPDX-License-Identifier: Apache-2.0
 */

/* Default SRAM planning when building for nRF5340 with
 * ARM TrustZone-M support
 * - Lowest 448 kB SRAM allocated to Secure application
 * - Upper 64 kB SRAM allocated as Shared memory (sram0_shared)
 *   (see nrf5340_audio_dk_nrf5340_shared_sram_planning_conf.dts)
 */
&sram0_image {
	reg = <0x20000000 DT_SIZE_K(448)>;
};

&sram0_s {
	reg = <0x20000000 0x70000>;
};

/* Include shared RAM configuration file */
#include "nrf5340_audio_dk_nrf5340_shared_sram_planning_conf.dts"
