## boards/arm/nrf5340_audio_dk_nrf5340/Kconfig.defconfig
```kconfig
# nRF5340 Audio DK board configuration

# Copyright (c) 2019 Nordic Semiconductor ASA
# SPDX-License-Identifier: Apache-2.0

if BOARD_NRF5340_AUDIO_DK_NRF5340_CPUAPP

config BOARD
	default "nrf5340_audio_dk_nrf5340_cpuapp"

# Workaround for not being able to have commas in macro arguments
DT_CHOSEN_Z_CODE_PARTITION := zephyr,code-partition
DT_CHOSEN_Z_SRAM_PARTITION := zephyr,sram-secure-partition

config FLASH_LOAD_SIZE
	default $(dt_chosen_reg_size_hex,$(DT_CHOSEN_Z_CODE_PARTITION))

config SRAM_SIZE
	default $(dt_chosen_reg_size_int,$(DT_CHOSEN_Z_SRAM_PARTITION),0,K)

endif # BOARD_NRF5340_AUDIO_DK_NRF5340_CPUAPP

config BOARD
	default "nrf5340_audio_dk_nrf5340_cpunet" if BOARD_NRF5340_AUDIO_DK_NRF5340_CPUNET

config IPM_NRFX
	default IPM

config MBOX_NRFX_IPC
	default MBOX

if BOARD_NRF5340_AUDIO_DK_NRF5340_CPUAPP

choice BT_HCI_BUS_TYPE
	default BT_RPMSG if BT
endchoice

config HEAP_MEM_POOL_SIZE
	default 4096 if BT_RPMSG

endif # BOARD_NRF5340_AUDIO_DK_NRF5340_CPUAPP

if BOARD_NRF5340_AUDIO_DK_NRF5340_CPUNET

config BT_CTLR
	default y if BT

endif # BOARD_NRF5340_AUDIO_DK_NRF5340_CPUNET

config UART_NRF_DK_SERIAL_WORKAROUND
	default y if ZTEST

# When the nRF DK serial workaround is enabled, increase the stack size in
# tests built with no optimizations, as the standard size may be insufficient
# then. Use 512 to align with the FPU_SHARING case, where the default value
# is also modified.
config TEST_EXTRA_STACK_SIZE
	default 512 if UART_NRF_DK_SERIAL_WORKAROUND && NO_OPTIMIZATIONS
```
