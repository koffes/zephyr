## CMakeLists.txt
```
# SPDX-License-Identifier: Apache-2.0

cmake_minimum_required(VERSION 3.20.0)
find_package(Zephyr REQUIRED HINTS $ENV{ZEPHYR_BASE})
project(bap_broadcast_assistant)

target_sources(app PRIVATE
  src/main.c
  src/display.c
  src/bt_ba.c
)

zephyr_library_include_directories(${ZEPHYR_BASE}/samples/bluetooth)
```

## sample.yaml
```
sample:
  description: Bluetooth Low Energy Broadcast Assistant sample
  name: Bluetooth Low Energy Broadcast Assistant sample
tests:
  sample.bluetooth.bap_broadcast_assistant:
    harness: bluetooth
    platform_allow:
      - nrf52840dk/nrf52840
      - nrf5340dk/nrf5340/cpuapp
    integration_platforms:
      - nrf52840dk/nrf52840
      - nrf5340dk/nrf5340/cpuapp
    tags: bluetooth
    sysbuild: true
```

## prj.conf
```kconfig
CONFIG_BT=y
CONFIG_LOG=y
CONFIG_BT_CENTRAL=y
CONFIG_BT_GATT_CLIENT=y
CONFIG_BT_GATT_AUTO_DISCOVER_CCC=y
CONFIG_BT_GATT_AUTO_UPDATE_MTU=y
CONFIG_UTF8=y
CONFIG_BT_AUDIO=y
CONFIG_BT_SMP=y
CONFIG_BT_BUF_ACL_RX_SIZE=255
CONFIG_BT_BUF_ACL_TX_SIZE=251
CONFIG_BT_CTLR_SCAN_DATA_LEN_MAX=191

CONFIG_BT_EXT_ADV=y
CONFIG_BT_PER_ADV_SYNC=y
CONFIG_BT_BAP_BASS_MAX_SUBGROUPS=2
CONFIG_BT_ISO_SYNC_RECEIVER=y
CONFIG_BT_BAP_BROADCAST_ASSISTANT=y
CONFIG_BT_AUDIO_CODEC_CFG_MAX_METADATA_SIZE=255

CONFIG_ASSERT=y
CONFIG_MIN_HEAP=y
CONFIG_THREAD_NAME=y


CONFIG_SYSTEM_WORKQUEUE_STACK_SIZE=4096
# LVGL Display Configuration

CONFIG_MAIN_STACK_SIZE=4000

CONFIG_INPUT=y
CONFIG_LOG=y

CONFIG_DISPLAY=y
CONFIG_DISPLAY_LOG_LEVEL_ERR=y
CONFIG_LVGL=y
CONFIG_LV_USE_LOG=y
CONFIG_LV_LOG_LEVEL_WARN=y 
CONFIG_LV_USE_LABEL=y
CONFIG_LV_Z_VDB_SIZE=100
CONFIG_LV_FONT_MONTSERRAT_24=y
CONFIG_LV_Z_MEM_POOL_SIZE=30000
CONFIG_LV_Z_LVGL_MUTEX=y
```

## src/main.c
```c
#include <zephyr/kernel.h>
#include <nrfx_clock.h>

#include "display.h"
#include "bt_ba.h"
#include "sr_info.h"

#define LOG_LEVEL CONFIG_LOG_DEFAULT_LEVEL
#include <zephyr/logging/log.h>
LOG_MODULE_REGISTER(main);

K_FIFO_DEFINE(fifo_brcast_snk);
K_FIFO_DEFINE(fifo_brcast_src);

static void on_snk_button_pressed(struct brcast_snk_info *sink_info)
{
	if (sink_info == NULL) {
		LOG_WRN("Sink button pressed for empty row");
		return;
	}

	k_fifo_put(&fifo_brcast_snk, sink_info);

	LOG_INF("Sink selected: %s", sink_info->name);
}

static void on_src_button_pressed(struct brcast_src_info *src_info)
{
	if (src_info == NULL) {
		LOG_WRN("Source button pressed for empty row");
		return;
	}

	k_fifo_put(&fifo_brcast_src, src_info);

	LOG_INF("Source selected: %s", src_info->name);
}

static void on_scan_result_sink(struct brcast_snk_info snk_inf)
{
	int ret;
	LOG_INF("Sink scan result: %s", snk_inf.name);
	ret = display_scan_result_snk_submit(snk_inf);
	if (ret != 0) {
		LOG_ERR("Failed to submit scan result (err %d)\n", ret);
	}
}

static void on_scan_result_source(struct brcast_src_info src_info)
{
	int ret;
	LOG_INF("Source scan result: bt='%s' broadcast='%s' id=0x%06x", src_info.name,
		src_info.name, src_info.broadcast_id);

	ret = display_scan_result_src_submit(src_info);
	if (ret != 0) {
		LOG_ERR("Failed to submit scan result (err %d)\n", ret);
	}
}

static void on_state_update(enum ba_states new_state)
{
	LOG_INF("State update: %d", new_state);
	display_state_set(new_state);
}

void set_cpu_to_128mhz(void)
{
#if NRFX_CLOCK_ENABLED && (defined(CLOCK_FEATURE_HFCLK_DIVIDE_PRESENT) || NRF_CLOCK_HAS_HFCLK192M)
	int err = nrfx_clock_divider_set(NRF_CLOCK_DOMAIN_HFCLK, NRF_CLOCK_HFCLK_DIV_1);
	if (err == 0) {
		LOG_INF("CPU frequency set to 128 MHz\n");
	} else {
		LOG_ERR("Failed to set 128 MHz\n");
	}
#endif
}

int main(void)
{
	int err;
	const struct bt_ba_callbacks bt_callbacks = {.scan_result_sink = on_scan_result_sink,
						     .scan_result_source = on_scan_result_source,
						     .state_update = on_state_update};
	const struct display_callbacks display_callbacks = {
		.snk_selected = on_snk_button_pressed,
		.src_selected = on_src_button_pressed,
	};

	set_cpu_to_128mhz();

	/* Initialize display */
	err = display_init(&display_callbacks);
	if (err != 0) {
		LOG_ERR("Display init failed (err %d)\n", err);
		return 0;
	}

	err = bt_ba_init(&bt_callbacks);
	if (err != 0) {
		LOG_ERR("Bluetooth init failed (err %d)\n", err);
		return 0;
	}

	LOG_INF("Broadcast Assistant started");

	err = bt_ba_scan_for_sink_start();
	if (err != 0) {
		LOG_ERR("Failed to start scan (err %d)\n", err);
	}

	LOG_INF("Scan for sink started");

	while (1) {
		k_sleep(K_MSEC(10));

		struct brcast_snk_info *sink_info = k_fifo_get(&fifo_brcast_snk, K_NO_WAIT);

		if (sink_info != NULL) {
			LOG_INF("Processing selected sink: %s", sink_info->name);
			err = bt_ba_sink_connect(sink_info);
			if (err != 0) {
				LOG_ERR("Failed to connect to sink (err %d)\n", err);
			}

			err = bt_ba_scan_for_source_start();
			if (err != 0) {
				LOG_ERR("Failed to start scan for source (err %d)\n", err);
			}
		}

		struct brcast_src_info *src_info = k_fifo_get(&fifo_brcast_src, K_NO_WAIT);
		if (src_info != NULL) {
			LOG_INF("Processing selected source: %s", src_info->name);
			err = bt_ba_source_sync_and_transfer(src_info);
			if (err != 0) {
				LOG_ERR("Failed to sync and transfer from source (err %d)\n", err);
			}
			LOG_INF("Source sync and transfer done");
		}
	}
}
```

## src/bt_ba.c
```c
/*
 * Copyright (c) 2024 Demant A/S
 * Copyright (c) 2024-2026 Nordic Semiconductor ASA
 *
 * SPDX-License-Identifier: Apache-2.0
 */

#include <errno.h>
#include <stdbool.h>
#include <stddef.h>
#include <stdint.h>
#include <string.h>
#include <strings.h>

#include <zephyr/autoconf.h>
#include <zephyr/bluetooth/addr.h>
#include <zephyr/bluetooth/assigned_numbers.h>
#include <zephyr/bluetooth/audio/audio.h>
#include <zephyr/bluetooth/audio/bap.h>
#include <zephyr/bluetooth/bluetooth.h>
#include <zephyr/bluetooth/conn.h>
#include <zephyr/bluetooth/gap.h>
#include <zephyr/bluetooth/hci.h>
#include <zephyr/bluetooth/hci_types.h>
#include <zephyr/bluetooth/iso.h>
#include <zephyr/bluetooth/uuid.h>
#include <zephyr/kernel.h>
#include <zephyr/net_buf.h>
#include <zephyr/sys/__assert.h>
#include <zephyr/sys/byteorder.h>
#include <zephyr/sys/util.h>
#include <zephyr/toolchain.h>
#include <zephyr/types.h>

#include "bt_ba.h"

#define LOG_LEVEL CONFIG_LOG_DEFAULT_LEVEL
#include <zephyr/logging/log.h>
LOG_MODULE_REGISTER(bt_ba);

#define PA_SYNC_SKIP                      5U
#define PA_SYNC_INTERVAL_TO_TIMEOUT_RATIO 20U /* Set the timeout relative to interval */
/* Broadcast IDs are 24bit, so this is out of valid range */
/* Default semaphore timeout when waiting for an action */
#define SEM_TIMEOUT                       K_SECONDS(10)

static struct bt_conn *broadcast_sink_conn;
static uint8_t remote_recv_state_count;
static struct bt_le_per_adv_sync *pa_sync;
static uint8_t received_base[UINT8_MAX];
static size_t received_base_size;
static struct bt_bap_bass_subgroup bass_subgroups[CONFIG_BT_BAP_BASS_MAX_SUBGROUPS];

static bool scanning_for_broadcast_source;
static struct bt_ba_callbacks app_callbacks;

static struct k_mutex base_store_mutex;
static K_SEM_DEFINE(sem_source_discovered, 0U, 1U);
static K_SEM_DEFINE(sem_sink_connected, 0U, 1U);
static K_SEM_DEFINE(sem_sink_disconnected, 0U, 1U);
static K_SEM_DEFINE(sem_security_updated, 0U, 1U);
static K_SEM_DEFINE(sem_bass_discovered, 0U, 1U);
static K_SEM_DEFINE(sem_recv_state_read, 0U, 1U);
static K_SEM_DEFINE(sem_pa_synced, 0U, 1U);
static K_SEM_DEFINE(sem_pa_sync_terminted, 0U, 1U);
static K_SEM_DEFINE(sem_received_base_subgroups, 0U, 1U);

struct scan_recv_info {
	char name[NAME_LEN];
	char broadcast_name[NAME_LEN];
	uint32_t broadcast_id;
	bool has_bass;
	bool has_pacs;
};

static bool device_found(struct bt_data *data, void *user_data)
{
	struct scan_recv_info *sr_info = (struct scan_recv_info *)user_data;
	struct bt_uuid_16 adv_uuid;

	switch (data->type) {
	case BT_DATA_NAME_SHORTENED:
	case BT_DATA_NAME_COMPLETE:
		memcpy(sr_info->name, data->data, MIN(data->data_len, NAME_LEN - 1));
		return true;
	case BT_DATA_BROADCAST_NAME:
		memcpy(sr_info->broadcast_name, data->data, MIN(data->data_len, NAME_LEN - 1));
		return true;
	case BT_DATA_SVC_DATA16:
		/* Check for Broadcast ID */
		if (data->data_len < BT_UUID_SIZE_16 + BT_AUDIO_BROADCAST_ID_SIZE) {
			return true;
		}

		if (!bt_uuid_create(&adv_uuid.uuid, data->data, BT_UUID_SIZE_16)) {
			return true;
		}

		if (bt_uuid_cmp(&adv_uuid.uuid, BT_UUID_BROADCAST_AUDIO) != 0) {
			return true;
		}

		sr_info->broadcast_id = sys_get_le24(data->data + BT_UUID_SIZE_16);
		return true;
	case BT_DATA_UUID16_SOME:
	case BT_DATA_UUID16_ALL:
		/* NOTE: According to the BAP 1.0.1 Spec,
		 * Section 3.9.2. Additional Broadcast Audio Scan Service requirements,
		 * If the Scan Delegator implements a Broadcast Sink, it should also
		 * advertise a Service Data field containing the Broadcast Audio
		 * Scan Service (BASS) UUID.
		 *
		 * However, it seems that this is not the case with the sinks available
		 * while developing this sample application.  Therefore, we instead,
		 * search for the existence of BASS and PACS in the list of service UUIDs,
		 * which does seem to exist in the sinks available.
		 */

		/* Check for BASS and PACS */
		if (data->data_len % sizeof(uint16_t) != 0U) {
			LOG_DBG("UUID16 AD malformed\n");
			return true;
		}

		for (size_t i = 0U; i < data->data_len; i += sizeof(uint16_t)) {
			const struct bt_uuid *uuid;
			uint16_t u16;

			memcpy(&u16, &data->data[i], sizeof(u16));
			uuid = BT_UUID_DECLARE_16(sys_le16_to_cpu(u16));

			if (bt_uuid_cmp(uuid, BT_UUID_BASS) == 0) {
				sr_info->has_bass = true;
				continue;
			}

			if (bt_uuid_cmp(uuid, BT_UUID_PACS) == 0) {
				sr_info->has_pacs = true;
				continue;
			}
		}
		return true;
	default:
		return true;
	}
}

static bool base_store(struct bt_data *data, void *user_data)
{
	const struct bt_bap_base *base = bt_bap_base_get_base_from_ad(data);
	int base_size;
	int base_subgroup_count;
	int err;

	ARG_UNUSED(user_data);

	/* Base is NULL if the data does not contain a valid BASE */
	if (base == NULL) {
		return true;
	}

	/* Can not fit all the received subgroups with the size CONFIG_BT_BAP_BASS_MAX_SUBGROUPS */
	base_subgroup_count = bt_bap_base_get_subgroup_count(base);
	if (base_subgroup_count < 0 || base_subgroup_count > CONFIG_BT_BAP_BASS_MAX_SUBGROUPS) {
		LOG_DBG("Got invalid subgroup count: %d\n", base_subgroup_count);
		return true;
	}

	base_size = bt_bap_base_get_size(base);
	if (base_size < 0) {
		LOG_DBG("BASE get size failed (%d)\n", base_size);

		return true;
	}

	/* Compare BASE and copy if different */
	err = k_mutex_lock(&base_store_mutex, K_MSEC(100));
	if (err != 0) {
		/* Could not get BASE mutex, wait for new to avoid blocking */
		return false;
	}

	if ((size_t)base_size != received_base_size ||
	    memcmp(base, received_base, (size_t)base_size) != 0) {
		(void)memcpy(received_base, base, base_size);
		received_base_size = (size_t)base_size;
	}
	err = k_mutex_unlock(&base_store_mutex);
	__ASSERT_NO_MSG(err == 0);

	/* Stop parsing */
	k_sem_give(&sem_received_base_subgroups);
	return false;
}

static void pa_recv(struct bt_le_per_adv_sync *sync,
		    const struct bt_le_per_adv_sync_recv_info *info, struct net_buf_simple *buf)
{
	ARG_UNUSED(sync);
	ARG_UNUSED(info);

	bt_data_parse(buf, base_store, NULL);
}

static bool add_pa_sync_base_subgroup_bis_cb(const struct bt_bap_base_subgroup_bis *bis,
					     void *user_data)
{
	struct bt_bap_bass_subgroup *subgroup_param = user_data;

	subgroup_param->bis_sync |= BT_ISO_BIS_INDEX_BIT(bis->index);

	return true;
}

static bool add_pa_sync_base_subgroup_cb(const struct bt_bap_base_subgroup *subgroup,
					 void *user_data)
{
	struct bt_bap_broadcast_assistant_add_src_param *param = user_data;
	struct bt_bap_bass_subgroup *subgroup_param;
	uint8_t *data;
	int ret;

	ret = bt_bap_base_get_subgroup_codec_meta(subgroup, &data);
	if (ret < 0) {
		return false;
	}

	subgroup_param = param->subgroups;

	if (ret > ARRAY_SIZE(subgroup_param->metadata)) {
		LOG_DBG("Cannot fit %d octets into subgroup param with size %zu", ret,
			ARRAY_SIZE(subgroup_param->metadata));
		return false;
	}

	ret = bt_bap_base_subgroup_foreach_bis(subgroup, add_pa_sync_base_subgroup_bis_cb,
					       subgroup_param);
	if (ret < 0) {
		return false;
	}

	param->num_subgroups++;

	return true;
}

static uint16_t interval_to_sync_timeout(uint16_t pa_interval)
{
	uint16_t pa_timeout;

	if (pa_interval == BT_BAP_PA_INTERVAL_UNKNOWN) {
		/* Use maximum value to maximize chance of success */
		pa_timeout = BT_GAP_PER_ADV_MAX_TIMEOUT;
	} else {
		uint32_t interval_us;
		uint32_t timeout;

		/* Add retries and convert to unit in 10's of ms */
		interval_us = BT_GAP_PER_ADV_INTERVAL_TO_US(pa_interval);
		timeout = BT_GAP_US_TO_PER_ADV_SYNC_TIMEOUT(interval_us) *
			  PA_SYNC_INTERVAL_TO_TIMEOUT_RATIO;

		/* Enforce restraints */
		pa_timeout = CLAMP(timeout, BT_GAP_PER_ADV_MIN_TIMEOUT, BT_GAP_PER_ADV_MAX_TIMEOUT);
	}

	return pa_timeout;
}

static void scan_recv_cb(const struct bt_le_scan_recv_info *info, struct net_buf_simple *ad)
{
	struct scan_recv_info sr_info = {0};

	if (scanning_for_broadcast_source) {
		/* Scan for and select Broadcast Source */

		sr_info.broadcast_id = BT_BAP_INVALID_BROADCAST_ID;

		/* We are only interested in non-connectable periodic advertisers */
		if ((info->adv_props & BT_GAP_ADV_PROP_CONNECTABLE) != 0 || info->interval == 0) {
			return;
		}

		bt_data_parse(ad, device_found, (void *)&sr_info);

		if (sr_info.broadcast_id != BT_BAP_INVALID_BROADCAST_ID) {
			LOG_INF("  Broadcast Name: %s\n", sr_info.broadcast_name);
			LOG_INF("  Broadcast ID:   0x%06x\n\n", sr_info.broadcast_id);

			struct brcast_src_info source_info = {0};
			memcpy(source_info.name, sr_info.broadcast_name,
			       sizeof(sr_info.broadcast_name));
			source_info.broadcast_id = sr_info.broadcast_id;
			source_info.sid = info->sid;
			source_info.pa_interval = info->interval;
			bt_addr_le_copy(&source_info.addr, info->addr);

			app_callbacks.scan_result_source(source_info);
		}
	} else {
		/* Scan for and connect to Broadcast Sink */

		/* We are only interested in connectable advertisers */
		if ((info->adv_props & BT_GAP_ADV_PROP_CONNECTABLE) == 0) {
			return;
		}

		bt_data_parse(ad, device_found, (void *)&sr_info);

		if (sr_info.has_bass && sr_info.has_pacs) {
			LOG_INF_RATELIMIT("  BT Name:        %s\n", sr_info.name);
			struct brcast_snk_info sink_info = {0};
			memcpy(sink_info.name, sr_info.name, sizeof(sr_info.name));
			bt_addr_le_copy(&sink_info.addr, info->addr);

			app_callbacks.scan_result_sink(sink_info);
		}
	}
}

static void scan_timeout_cb(void)
{
	LOG_DBG("Scan timeout\n");
}

static struct bt_le_scan_cb scan_callbacks = {
	.recv = scan_recv_cb,
	.timeout = scan_timeout_cb,
};

int bt_ba_scan_for_source_start(void)
{
	int err;

	scanning_for_broadcast_source = true;

	app_callbacks.state_update(STATE_SCANNING_FOR_SOURCE);

	err = bt_le_scan_start(BT_LE_SCAN_PASSIVE, NULL);
	if (err != 0) {
		LOG_DBG("Scanning failed to start (err %d)\n", err);
		return err;
	}

	LOG_DBG("Scanning for Broadcast Source successfully started\n");

	return 0;
}

static int scan_for_broadcast_sink(void)
{
	int err;

	scanning_for_broadcast_source = false;

	app_callbacks.state_update(STATE_SCANNING_FOR_SINK);

	err = bt_le_scan_start(BT_LE_SCAN_PASSIVE, NULL);
	if (err != 0) {
		LOG_WRN("Scanning failed to start (err %d)\n", err);
		return err;
	}

	LOG_DBG("Scanning for Broadcast Sink successfully started\n");
	return 0;
}

static void connected(struct bt_conn *conn, uint8_t err)
{
	if (err != 0) {
		LOG_ERR("Failed to connect to %s %u %s\n", bt_conn_dst_str(conn), err,
			bt_hci_err_to_str(err));

		bt_conn_unref(broadcast_sink_conn);
		broadcast_sink_conn = NULL;

		return;
	}

	if (conn != broadcast_sink_conn) {
		return;
	}

	LOG_INF("Connected: %s\n", bt_conn_dst_str(conn));
	k_sem_give(&sem_sink_connected);
}

static void disconnected(struct bt_conn *conn, uint8_t reason)
{
	if (conn != broadcast_sink_conn) {
		return;
	}

	LOG_DBG("Disconnected: %s, reason 0x%02x %s\n", bt_conn_dst_str(conn), reason,
		bt_hci_err_to_str(reason));

	bt_conn_unref(broadcast_sink_conn);
	broadcast_sink_conn = NULL;

	k_sem_give(&sem_sink_disconnected);
}

static void security_changed_cb(struct bt_conn *conn, bt_security_t level, enum bt_security_err err)
{
	if (conn != broadcast_sink_conn) {
		return;
	}

	if (err == 0) {
		LOG_INF("Security level changed OK: %u", level);
		k_sem_give(&sem_security_updated);
	} else {
		LOG_ERR("Failed to set security level: %s(%u)", bt_security_err_to_str(err), err);
	}
}

static void bap_broadcast_assistant_discover_cb(struct bt_conn *conn, int err,
						uint8_t recv_state_count)
{
	ARG_UNUSED(conn);

	if (err == 0) {
		LOG_DBG("BASS discover done with %u recv states\n", recv_state_count);
		remote_recv_state_count = recv_state_count;
		k_sem_give(&sem_bass_discovered);
	} else {
		LOG_DBG("BASS discover failed (%d)\n", err);
	}
}

static void bap_broadcast_assistant_add_src_cb(struct bt_conn *conn, int err)
{
	ARG_UNUSED(conn);

	if (err == 0) {
		LOG_DBG("BASS add source successful\n");
	} else {
		LOG_DBG("BASS add source failed (%d)\n", err);
	}
}

static void
bap_broadcast_assistant_recv_state_read_cb(struct bt_conn *conn, int err,
					   const struct bt_bap_scan_delegator_recv_state *state)
{
	ARG_UNUSED(conn);

	if (err != 0) {
		LOG_DBG("BASS recv state read failed (%d)\n", err);
		return;
	}

	if (state != NULL) {
		LOG_DBG("BASS recv state: src_id %u, addr %s, sid %u, sync_state %u, encrypt_state "
			"%u, num_subgroups %u\n",
			state->src_id, bt_addr_le_str(&state->addr), state->adv_sid,
			state->pa_sync_state, state->encrypt_state, state->num_subgroups);

		for (uint8_t i = 0U; i < state->num_subgroups; i++) {
			const struct bt_bap_bass_subgroup *subgroup = &state->subgroups[i];

			LOG_DBG("\t[%d]: BIS sync %u, metadata_len %u\n", i, subgroup->bis_sync,
				subgroup->metadata_len);
		}
	} /* else empty receive state */

	k_sem_give(&sem_recv_state_read);
}

static void pa_sync_synced_cb(struct bt_le_per_adv_sync *sync,
			      struct bt_le_per_adv_sync_synced_info *info)
{
	ARG_UNUSED(info);

	if (sync == pa_sync) {
		LOG_INF("PA sync synced for broadcast sink");

		k_sem_give(&sem_pa_synced);
	}
}
static void pa_sync_term_cb(struct bt_le_per_adv_sync *sync,
			    const struct bt_le_per_adv_sync_term_info *info)
{
	if (sync == pa_sync) {
		LOG_DBG("PA sync %p terminated with reason %u\n", sync, info->reason);

		k_sem_give(&sem_pa_sync_terminted);
		pa_sync = NULL;
	}
}

static struct bt_bap_broadcast_assistant_cb ba_cbs = {
	.discover = bap_broadcast_assistant_discover_cb,
	.add_src = bap_broadcast_assistant_add_src_cb,
	.recv_state = bap_broadcast_assistant_recv_state_read_cb,
};

static struct bt_le_per_adv_sync_cb pa_synced_cb = {
	.synced = pa_sync_synced_cb,
	.term = pa_sync_term_cb,
	.recv = pa_recv,
};

static void reset(void)
{
	int err;

	LOG_INF("\n\nResetting...\n\n");

	if (broadcast_sink_conn != NULL) {
		err = bt_conn_disconnect(broadcast_sink_conn, BT_HCI_ERR_LOCALHOST_TERM_CONN);

		if (err != 0) {
			LOG_ERR("bt_conn_disconnect failed with %d\n", err);
		} else {
			if (k_sem_take(&sem_sink_disconnected, SEM_TIMEOUT) != 0) {
				/* This should not happen */

				__ASSERT_NO_MSG(false);
			}
		}
		__ASSERT_NO_MSG(err == 0);
	}

	/* Ignore return value as scanning may already be stopped */
	(void)bt_le_scan_stop();

	if (pa_sync != NULL) {
		err = bt_le_per_adv_sync_delete(pa_sync);

		if (err != 0) {
			LOG_DBG("bt_le_per_adv_sync_delete failed with %d\n", err);
		} else {
			if (k_sem_take(&sem_pa_sync_terminted, SEM_TIMEOUT) != 0) {
				/* This should not happen */

				__ASSERT_NO_MSG(false);
			}
		}
		__ASSERT_NO_MSG(err == 0);
	}

	k_sem_reset(&sem_source_discovered);
	k_sem_reset(&sem_sink_connected);
	k_sem_reset(&sem_sink_disconnected);
	k_sem_reset(&sem_security_updated);
	k_sem_reset(&sem_bass_discovered);
	k_sem_reset(&sem_pa_synced);
	k_sem_reset(&sem_received_base_subgroups);

	app_callbacks.state_update(STATE_IDLE);
}

BT_CONN_CB_DEFINE(conn_callbacks) = {.connected = connected,
				     .disconnected = disconnected,
				     .security_changed = security_changed_cb};

static int read_recv_states(void)
{
	/* Attempts to read all found receive states - Some or all may be empty */
	for (uint8_t i = 0U; i < remote_recv_state_count; i++) {
		int err;

		err = bt_bap_broadcast_assistant_read_recv_state(broadcast_sink_conn, i);

		if (err != 0) {
			LOG_DBG("Failed to read receive state[%u]: %d\n", i, err);

			return err;
		}

		err = k_sem_take(&sem_recv_state_read, SEM_TIMEOUT);
		if (err != 0) {
			LOG_DBG("Failed to take sem_recv_state_read: %d\n", err);

			return err;
		}
	}

	return 0;
}

int bt_ba_scan_stop(void)
{
	int err;

	err = bt_le_scan_stop();
	if (err != 0) {
		LOG_DBG("bt_le_scan_stop failed with %d\n", err);
		return err;
	}

	LOG_DBG("Scanning successfully stopped\n");
	return 0;
}

int bt_ba_sink_connect(const struct brcast_snk_info *info)
{
	int err;

	if (info == NULL) {
		LOG_ERR("Sink info is NULL\n");
		return -EINVAL;
	}

	k_sem_reset(&sem_security_updated);

	err = bt_le_scan_stop();
	if (err != 0) {
		LOG_ERR("bt_le_scan_stop failed with %d", err);
		return err;
	}

	LOG_INF("The value of broadcast_sink_conn before connection attempt: %p\n",
		broadcast_sink_conn);

	app_callbacks.state_update(STATE_CONNECTING_TO_SINK);

	err = bt_conn_le_create(&info->addr, BT_CONN_LE_CREATE_CONN, BT_BAP_CONN_PARAM_RELAXED,
				&broadcast_sink_conn);
	if (err != 0) {
		LOG_ERR("Failed creating connection (err=%u)", err);
		return err;
	}

	LOG_INF("Connecting to Broadcast Sink at %s. Waiting..", bt_addr_le_str(&info->addr));

	err = k_sem_take(&sem_sink_connected, SEM_TIMEOUT);
	if (err != 0) {
		LOG_ERR("Failed to take sem_sink_connected (err %d)\n", err);
		return err;
	}

	app_callbacks.state_update(STATE_CONNECTED_TO_SINK);

	LOG_INF("Connected to Broadcast Sink at %s\n", bt_addr_le_str(&info->addr));

	app_callbacks.state_update(STATE_SETTING_SECURITY);

	err = bt_conn_set_security(broadcast_sink_conn, BT_SECURITY_L2);
	if (err != 0) {
		LOG_ERR("Failed to set security: %d", err);
		return err;
	}

	LOG_INF("Waiting for security update from %s\n", bt_addr_le_str(&info->addr));

	err = k_sem_take(&sem_security_updated, SEM_TIMEOUT);
	if (err != 0) {
		LOG_ERR("Failed to take sem_security_updated (err %d)\n", err);
		return err;
	}

	app_callbacks.state_update(STATE_SECURITY_CHANGED);

	err = bt_bap_broadcast_assistant_discover(broadcast_sink_conn);
	if (err != 0) {
		LOG_ERR("Failed to discover BASS on the sink (err %d)", err);
		return err;
	}

	err = read_recv_states();
	if (err != 0) {
		LOG_ERR("Failed to read receive states\n");
		return err;
	}

	app_callbacks.state_update(STATE_DISCOVERY_DONE);

	return 0;
}

int bt_ba_source_sync_and_transfer(const struct brcast_src_info *info)
{
	int err;
	LOG_DBG("Attempting to PA sync to the broadcaster with id 0x%06X\n", info->broadcast_id);

	struct bt_bap_broadcast_assistant_add_src_param param = {0};

	err = bt_le_scan_stop();
	if (err != 0) {
		LOG_ERR("Failed to stop scanning (err %d)\n", err);
		return err;
	}

	struct bt_le_per_adv_sync_param create_params = {0};

	bt_addr_le_copy(&create_params.addr, &info->addr);
	create_params.options = BT_LE_PER_ADV_SYNC_OPT_FILTER_DUPLICATE;
	create_params.sid = info->sid;
	create_params.skip = PA_SYNC_SKIP;
	create_params.timeout = interval_to_sync_timeout(info->pa_interval);

	app_callbacks.state_update(STATE_PER_ADV_SYNC_CREATE);

	err = bt_le_per_adv_sync_create(&create_params, &pa_sync);
	if (err != 0) {
		LOG_ERR("Could not create Broadcast PA sync: %d\n", err);
		return err;
	}

	LOG_INF("Waiting for PA synced\n");
	err = k_sem_take(&sem_pa_synced, SEM_TIMEOUT);
	if (err != 0) {
		LOG_ERR("Failed to take sem_pa_synced (err %d)\n", err);
		return err;
	}

	app_callbacks.state_update(STATE_PER_ADV_SYNC_CREATED);

	memset(bass_subgroups, 0, sizeof(bass_subgroups));
	bt_addr_le_copy(&param.addr, &info->addr);
	param.adv_sid = info->sid;
	param.pa_interval = info->pa_interval;
	param.broadcast_id = info->broadcast_id;
	param.pa_sync = true;
	param.subgroups = bass_subgroups;

	/* Wait to receive subgroups */
	err = k_sem_take(&sem_received_base_subgroups, K_FOREVER);
	if (err != 0) {
		LOG_ERR("Failed to take sem_received_base_subgroups (err %d)\n", err);
		return err;
	}

	err = k_mutex_lock(&base_store_mutex, K_FOREVER);
	if (err != 0) {
		LOG_ERR("Failed to lock base_store_mutex (err %d)\n", err);
		return err;
	}

	err = bt_bap_base_foreach_subgroup((const struct bt_bap_base *)received_base,
					   add_pa_sync_base_subgroup_cb, &param);
	err = k_mutex_unlock(&base_store_mutex);
	if (err != 0) {
		LOG_ERR("Failed to unlock base_store_mutex (err %d)\n", err);
		return err;
	}

	if (err != 0) {
		LOG_ERR("Could not add BASE to params %d\n", err);
		return err;
	}

	app_callbacks.state_update(STATE_ADDING_SOURCE);

	err = bt_bap_broadcast_assistant_add_src(broadcast_sink_conn, &param);
	if (err != 0) {
		LOG_ERR("Failed to add source: %d\n", err);
		return err;
	}

	app_callbacks.state_update(STATE_ADDED_SOURCE);

	return 0;
}

int bt_ba_scan_for_sink_start(void)
{
	int err;
	err = scan_for_broadcast_sink();
	if (err != 0) {
		LOG_ERR("Failed to start scan (err %d)\n", err);
		return err;
	}

	return 0;
}

int bt_ba_init(const struct bt_ba_callbacks *callbacks)
{
	int err;

	if (callbacks != NULL) {
		app_callbacks = *callbacks;
	} else {
		(void)memset(&app_callbacks, 0, sizeof(app_callbacks));
	}

	err = bt_enable(NULL);
	if (err != 0) {
		LOG_DBG("Bluetooth init failed (err %d)\n", err);
		return err;
	}

	bt_bap_broadcast_assistant_register_cb(&ba_cbs);
	bt_le_per_adv_sync_cb_register(&pa_synced_cb);
	bt_le_scan_cb_register(&scan_callbacks);

	k_mutex_init(&base_store_mutex);

	reset();

	return 0;
}
```

## src/bt_ba.h
```c
#ifndef BT_BA_H_
#define BT_BA_H_

#include <stdint.h>
#include <zephyr/bluetooth/addr.h>

#include "sr_info.h"

struct bt_ba_callbacks {
	void (*scan_result_sink)(const struct brcast_snk_info info);
	void (*scan_result_source)(const struct brcast_src_info info);
	void (*state_update)(enum ba_states new_state);
};

int bt_ba_sink_connect(const struct brcast_snk_info *info);

int bt_ba_scan_stop(void);

int bt_ba_scan_for_sink_start(void);

int bt_ba_scan_for_source_start(void);

int bt_ba_source_sync_and_transfer(const struct brcast_src_info *info);

int bt_ba_init(const struct bt_ba_callbacks *callbacks);

#endif /* BT_BA_H_ */
```

## src/display.c
```c
/*
 * Copyright (c) 2024-2026 Nordic Semiconductor ASA
 *
 * SPDX-License-Identifier: Apache-2.0
 */

#include "display.h"
#include <zephyr/sys/printk.h>
#include <zephyr/device.h>
#include <zephyr/devicetree.h>
#include <zephyr/drivers/display.h>
#include <zephyr/kernel.h>
#include "lvgl_zephyr.h"

#include <zephyr/sys/min_heap.h>
#include <zephyr/sys/util.h>
#include <lvgl.h>

#include "sr_info.h"

#define LOG_LEVEL CONFIG_LOG_DEFAULT_LEVEL
#include <zephyr/logging/log.h>
LOG_MODULE_REGISTER(display);

#define DEVICES_MAX         6
#define V_OFFSET_PIXELS     35
#define TOP_BUTTON_WIDTH    100

static lv_obj_t *screen_snks;
static lv_obj_t *screen_srcs;
static lv_style_t style_common;

static lv_obj_t *screen_snks_name[DEVICES_MAX];
static lv_obj_t *screen_snks_since_seen[DEVICES_MAX];
static lv_obj_t *screen_snks_btn[DEVICES_MAX];
static lv_obj_t *screen_srcs_name[DEVICES_MAX];
static lv_obj_t *screen_srcs_since_seen[DEVICES_MAX];
static lv_obj_t *screen_srcs_btn[DEVICES_MAX];

static lv_obj_t *screen_snks_status_label;
static lv_obj_t *screen_srcs_status_label;
static lv_obj_t *screen_all_status_label;

static lv_style_t style_btn_trans;
static lv_style_t style_btn_default;
static struct display_callbacks app_callbacks;
static const struct device *display_dev_ref;

static int name_cmp(const void *a, const void *b)
{
	const struct brcast_snk_info *lhs = a;
	const struct brcast_snk_info *rhs = b;

	return strcmp(lhs->name, rhs->name);
}

static bool brcast_snk_name_match(const void *node, const void *other)
{
	const struct brcast_snk_info *sink = node;
	const char *name = other;

	return strcmp(sink->name, name) == 0;
}

static bool brcast_src_name_match(const void *node, const void *other)
{
	const struct brcast_src_info *src = node;
	const char *name = other;

	return strcmp(src->name, name) == 0;
}

MIN_HEAP_DEFINE_STATIC(brcast_snk_heap, DEVICES_MAX, sizeof(struct brcast_snk_info),
		       __alignof__(struct brcast_snk_info), name_cmp);

MIN_HEAP_DEFINE_STATIC(brcast_src_heap, DEVICES_MAX, sizeof(struct brcast_src_info),
		       __alignof__(struct brcast_src_info), name_cmp);

/* 320 pixels * 32 bpp (4 bytes/pixel) worst-case line buffer */
static uint8_t display_clear_line_buf[320 * 4];

static int display_hw_clear_white(const struct device *display_dev)
{
	struct display_capabilities caps;
	struct display_buffer_descriptor desc = {0};
	uint8_t bytes_per_pixel;
	size_t line_size;

	display_get_capabilities(display_dev, &caps);

	bytes_per_pixel = DISPLAY_BITS_PER_PIXEL(caps.current_pixel_format) / 8U;
	if (bytes_per_pixel == 0U || bytes_per_pixel > 4U) {
		LOG_ERR("Unsupported pixel format: 0x%x", caps.current_pixel_format);
		return -ENOTSUP;
	}

	line_size = caps.x_resolution * bytes_per_pixel;
	if (line_size > sizeof(display_clear_line_buf)) {
		LOG_ERR("Clear buffer too small for %ux%u", caps.x_resolution, caps.y_resolution);
		return -ENOMEM;
	}

	memset(display_clear_line_buf, 0xFF, line_size);

	desc.width = caps.x_resolution;
	desc.pitch = caps.x_resolution;
	desc.height = 1U;
	desc.buf_size = line_size;

	for (uint16_t y = 0U; y < caps.y_resolution; y++) {
		int err = display_write(display_dev, 0U, y, &desc, display_clear_line_buf);

		if (err != 0) {
			LOG_ERR("display_write failed on line %u (%d)", y, err);
			return err;
		}
	}

	return 0;
}

static uint8_t since_seen_string_gen(char *buf, uint32_t since_seen_s)
{
	if (since_seen_s < 5) {
		return sprintf(buf, "#00ff00 <5 s#");
	} else if (since_seen_s < 10) {
		return sprintf(buf, "#ff9900 <10 s#");
	} else if (since_seen_s < 30) {
		return sprintf(buf, "#ff9900 <30 s#");
	} else if (since_seen_s <= 60) {
		return sprintf(buf, "#ff0000 <60 s#");
	} else if (since_seen_s <= 3600) {
		return sprintf(buf, "#ff0000 ~%d m#", since_seen_s / 60);
	} else {
		return sprintf(buf, "#ff0000 ~%d h#", since_seen_s / 3600);
	}
}

static void page_snks_draw(void)
{
	struct brcast_snk_info *sink;
	int row = 0;
	char buf[25] = {'\0'};

	MIN_HEAP_FOREACH(&brcast_snk_heap, sink) {

		// LOG_WRN_RATELIMIT("name: %s, last_seen: %lld", sink->name, sink->last_seen);

		since_seen_string_gen(buf, (uint32_t)(k_uptime_get() - sink->last_seen) / 1000);
		lv_label_set_text(screen_snks_since_seen[row], buf);
		lv_label_set_text(screen_snks_name[row], sink->name);
		row++;
	}

	for (; row < DEVICES_MAX; row++) {
		sprintf(buf, "----------------");
		lv_label_set_text(screen_snks_name[row], buf);
		sprintf(buf, "------");
		lv_label_set_text(screen_snks_since_seen[row], buf);
	}
}

static void page_srcs_draw(void)
{
	struct brcast_src_info *source;
	int row = 0;
	char buf[25] = {'\0'};

	MIN_HEAP_FOREACH(&brcast_src_heap, source) {

		LOG_WRN_RATELIMIT("name: %s, last_seen: %lld", source->name, source->last_seen);

		since_seen_string_gen(buf, (uint32_t)(k_uptime_get() - source->last_seen) / 1000);
		lv_label_set_text(screen_srcs_since_seen[row], buf);
		lv_label_set_text(screen_srcs_name[row], source->name);
		row++;
	}

	for (; row < DEVICES_MAX; row++) {
		sprintf(buf, "***************");
		lv_label_set_text(screen_srcs_name[row], buf);
		sprintf(buf, "*******");
		lv_label_set_text(screen_srcs_since_seen[row], buf);
	}
}

static void timer_worker(struct k_work *work)
{
	lvgl_lock();
	if (lv_scr_act() == screen_snks) {
		page_snks_draw();
		lv_obj_invalidate(screen_all_status_label);

	} else if (lv_scr_act() == screen_srcs) {
		page_srcs_draw();
		lv_obj_invalidate(screen_all_status_label);
	} else {
		LOG_ERR("Unknown screen active.");
	}

	lv_timer_handler();
	lvgl_unlock();
}

K_WORK_DEFINE(timer_work, timer_worker);

static void gui_update_timer_handler(struct k_timer *dummy)
{
	k_work_submit(&timer_work);
};

K_TIMER_DEFINE(gui_update_timer, gui_update_timer_handler, NULL);

int display_scan_result_snk_submit(struct brcast_snk_info snk_info)
{
	int ret;
	uint64_t time_now = k_uptime_get();
	struct brcast_snk_info *brcast_snk_info_loc;
	struct brcast_snk_info removed_item;
	size_t found_idx = 0U;

	/* Update existing device */
	brcast_snk_info_loc =
		min_heap_find(&brcast_snk_heap, brcast_snk_name_match, snk_info.name, &found_idx);
	if (brcast_snk_info_loc != NULL) {
		brcast_snk_info_loc->last_seen = time_now;
		brcast_snk_info_loc->update = true;
		LOG_DBG("Updated existing device: %s", snk_info.name);
		return 0;
	}

	ret = min_heap_push(&brcast_snk_heap, &snk_info);
	if (ret == 0) {
		LOG_INF("Added new device: %s", snk_info.name);
		return 0;
	}

	/* Heap full: remove oldest seen sink and insert the new one */
	if (brcast_snk_heap.size > 0U) {
		size_t oldest_idx = 0U;
		uint64_t oldest_time = UINT64_MAX;

		for (size_t i = 0U; i < brcast_snk_heap.size; i++) {
			brcast_snk_info_loc = min_heap_get_element(&brcast_snk_heap, i);
			if (brcast_snk_info_loc->last_seen < oldest_time) {
				oldest_time = brcast_snk_info_loc->last_seen;
				oldest_idx = i;
			}
		}

		if (min_heap_remove(&brcast_snk_heap, oldest_idx, &removed_item) &&
		    min_heap_push(&brcast_snk_heap, &snk_info) == 0) {
			LOG_INF("Replaced oldest device: %s", snk_info.name);
			return 0;
		}

		LOG_ERR("Failed to replace oldest device: %s", snk_info.name);
		return -ENOMEM;
	} else {
		LOG_ERR("No available slot for new device: %s", snk_info.name);
		return -ENOENT;
	}
}

int display_scan_result_src_submit(struct brcast_src_info src_info)
{
	int ret;
	uint64_t time_now = k_uptime_get();
	struct brcast_src_info *brcast_src_info_loc;
	struct brcast_src_info removed_item;
	size_t found_idx = 0U;

	/* Update existing device */
	brcast_src_info_loc =
		min_heap_find(&brcast_src_heap, brcast_src_name_match, src_info.name, &found_idx);
	if (brcast_src_info_loc != NULL) {
		brcast_src_info_loc->last_seen = time_now;
		brcast_src_info_loc->update = true;
		LOG_DBG("Updated existing device: %s", src_info.name);
		return 0;
	}

	ret = min_heap_push(&brcast_src_heap, &src_info);
	if (ret == 0) {
		LOG_INF("Added new device: %s", src_info.name);
		return 0;
	}

	/* Heap full: remove oldest seen source and insert the new one */
	if (brcast_src_heap.size > 0U) {
		size_t oldest_idx = 0U;
		uint64_t oldest_time = UINT64_MAX;

		for (size_t i = 0U; i < brcast_src_heap.size; i++) {
			brcast_src_info_loc = min_heap_get_element(&brcast_src_heap, i);
			if (brcast_src_info_loc->last_seen < oldest_time) {
				oldest_time = brcast_src_info_loc->last_seen;
				oldest_idx = i;
			}
		}

		if (min_heap_remove(&brcast_src_heap, oldest_idx, &removed_item) &&
		    min_heap_push(&brcast_src_heap, &src_info) == 0) {
			LOG_INF("Replaced oldest device: %s", src_info.name);
			return 0;
		}

		LOG_ERR("Failed to replace oldest device: %s", src_info.name);
		return -ENOMEM;
	} else {
		LOG_ERR("No available slot for new device: %s", src_info.name);
		return -ENOENT;
	}
}

static struct brcast_snk_info *sink_from_button_index(uint8_t sink_index)
{
	if (sink_index >= brcast_snk_heap.size) {
		return NULL;
	}

	return min_heap_get_element(&brcast_snk_heap, sink_index);
}

static struct brcast_src_info *src_from_button_index(uint8_t src_index)
{
	if (src_index >= brcast_src_heap.size) {
		return NULL;
	}

	return min_heap_get_element(&brcast_src_heap, src_index);
}

static void btn_sink_select(lv_event_t *event)
{
	__ASSERT(app_callbacks.snk_selected != NULL, "Sink selected callback is not set");
	int device = (int)(uintptr_t)lv_event_get_user_data(event);
	struct brcast_snk_info *sink_info = sink_from_button_index((uint8_t)device);
	LOG_INF("Button event: %d", device);

	app_callbacks.snk_selected(sink_info);
}

static void btn_src_select(lv_event_t *event)
{
	__ASSERT(app_callbacks.src_selected != NULL, "Source selected callback is not set");
	int device = (int)(uintptr_t)lv_event_get_user_data(event);
	struct brcast_src_info *src_info = src_from_button_index((uint8_t)device);
	LOG_INF("Button event: %d", device);

	app_callbacks.src_selected(src_info);
}

static void sinks_screen_set(void)
{

	display_hw_clear_white(display_dev_ref);

	lv_scr_load(screen_snks);
	page_snks_draw();
	lv_obj_invalidate(screen_snks);
	for (int i = 0; i < DEVICES_MAX; i++) {
		lv_obj_invalidate(screen_snks_name[i]);
		lv_obj_invalidate(screen_snks_since_seen[i]);
		lv_obj_invalidate(screen_snks_btn[i]);

		lv_refr_now(NULL);
	}
}

static void sources_screen_set(void)
{

	display_hw_clear_white(display_dev_ref);

	lv_scr_load(screen_srcs);
	page_srcs_draw();
	lv_obj_invalidate(screen_srcs);
	for (int i = 0; i < DEVICES_MAX; i++) {
		lv_obj_invalidate(screen_srcs_name[i]);
		lv_obj_invalidate(screen_srcs_since_seen[i]);
		lv_obj_invalidate(screen_srcs_btn[i]);
	}

	lv_refr_now(NULL);
}

void display_state_set(enum ba_states new_state)
{
	lvgl_lock();
	char buf[40] = {'\0'};

	switch (new_state) {
	case STATE_IDLE:
		sinks_screen_set();
		screen_all_status_label = screen_snks_status_label;
		sprintf(buf, "Idle");
		break;
	case STATE_SCANNING_FOR_SINK:
		sprintf(buf, "Scan for sinks");
		break;
	case STATE_CONNECTING_TO_SINK:
		sprintf(buf, "Conn to sink");
		break;
	case STATE_CONNECTED_TO_SINK:
		sprintf(buf, "Conn'd to sink");
		break;
	case STATE_SETTING_SECURITY:
		sprintf(buf, "Setting sec");
		break;
	case STATE_SECURITY_CHANGED:
		sprintf(buf, "Sec changed");
		break;
	case STATE_DISCOVERY_DONE:
		sprintf(buf, "Discover done");
		break;
	case STATE_SCANNING_FOR_SOURCE:
		sources_screen_set();
		screen_all_status_label = screen_srcs_status_label;
		sprintf(buf, "Scan for srcs");
		break;
	case STATE_PER_ADV_SYNC_CREATE:
		sprintf(buf, "Creating per adv sync");
		break;
	case STATE_PER_ADV_SYNC_CREATED:
		sprintf(buf, "Per adv sync created");
		break;
	case STATE_ADDING_SOURCE:
		sprintf(buf, "Adding src");
		break;
	case STATE_ADDED_SOURCE:
		sprintf(buf, "Src added");
		break;
	default:
		sprintf(buf, "Unknown state");
		LOG_ERR("Unknown state: %d", new_state);
	}

	char steps_buf[10] = {'\0'};
	sprintf(steps_buf, " %d/%d", new_state, STATE_STEPS_MAX - 1);
	strcat(buf, steps_buf);
	lv_label_set_text(screen_all_status_label, buf);

	lvgl_unlock();
	return;
}

int display_init(const struct display_callbacks *callbacks)
{
	const struct device *display_dev;
	int ret;

	__ASSERT(callbacks != NULL, "Display callbacks must be provided");

	lvgl_lock();
	app_callbacks = *callbacks;

	brcast_snk_heap.size = 0U;

	display_dev = DEVICE_DT_GET(DT_CHOSEN(zephyr_display));
	if (!device_is_ready(display_dev)) {
		LOG_ERR("Device not ready, aborting test");
		return 0;
	}
	display_dev_ref = display_dev;

	ret = display_blanking_off(display_dev);
	if (ret < 0 && ret != -ENOSYS) {
		LOG_ERR("Failed to turn blanking off (error %d)", ret);
		return 0;
	}

	ret = display_hw_clear_white(display_dev);
	if (ret != 0) {
		LOG_WRN("Hardware clear failed (%d), continuing", ret);
	}

	k_sleep(K_MSEC(100));

	screen_snks = lv_obj_create(NULL);
	screen_srcs = lv_obj_create(NULL);
	lv_scr_load(screen_snks);

	lv_style_init(&style_common);
	lv_style_set_bg_color(&style_common, lv_color_white());
	lv_style_set_bg_opa(&style_common, LV_OPA_COVER);
	lv_obj_t *act_scr = lv_scr_act();
	lv_obj_add_style(act_scr, &style_common, LV_STATE_DEFAULT);

	lv_style_set_text_font(&style_common, &lv_font_montserrat_24);

	/* Give source screen its own opaque white background */
	lv_obj_set_style_bg_color(screen_srcs, lv_color_white(), LV_STATE_DEFAULT);
	lv_obj_set_style_bg_opa(screen_srcs, LV_OPA_COVER, LV_STATE_DEFAULT);
	lv_disp_t *disp = lv_disp_get_default();
	int width = lv_disp_get_hor_res(disp);
	// int height = lv_disp_get_ver_res(disp);

	/* snks page */

	lv_style_init(&style_btn_default);
	lv_style_set_bg_color(&style_btn_default, lv_color_hex(0x6bbf59));
	lv_style_set_bg_opa(&style_btn_default, LV_OPA_COVER);
	lv_style_set_border_color(&style_btn_default, lv_color_hex(0x1f3a1f));
	lv_style_set_border_width(&style_btn_default, 2);
	lv_style_set_radius(&style_btn_default, 4);

	lv_style_init(&style_btn_trans);
	lv_style_set_bg_opa(&style_btn_trans, LV_OPA_TRANSP);

	for (int i = 0; i < DEVICES_MAX; i++) {
		screen_snks_btn[i] = lv_btn_create(screen_snks);
		lv_obj_set_pos(screen_snks_btn[i], 0, (i * V_OFFSET_PIXELS) + V_OFFSET_PIXELS);
		lv_obj_set_size(screen_snks_btn[i], 320, V_OFFSET_PIXELS);
		lv_obj_add_style(screen_snks_btn[i], &style_btn_trans,
				 LV_PART_MAIN | LV_STATE_DEFAULT);
		lv_obj_add_event_cb(screen_snks_btn[i], btn_sink_select, LV_EVENT_PRESSED,
				    (void *)(uintptr_t)i);

		screen_srcs_btn[i] = lv_btn_create(screen_srcs);
		lv_obj_set_pos(screen_srcs_btn[i], 0, (i * V_OFFSET_PIXELS) + V_OFFSET_PIXELS);
		lv_obj_set_size(screen_srcs_btn[i], 320, V_OFFSET_PIXELS);
		lv_obj_add_style(screen_srcs_btn[i], &style_btn_trans,
				 LV_PART_MAIN | LV_STATE_DEFAULT);
		lv_obj_add_event_cb(screen_srcs_btn[i], btn_src_select, LV_EVENT_PRESSED,
				    (void *)(uintptr_t)i);

		screen_snks_name[i] = lv_label_create(screen_snks);
		lv_label_set_recolor(screen_snks_name[i], true);
		lv_obj_align(screen_snks_name[i], LV_ALIGN_TOP_LEFT, 0,
			     (i * V_OFFSET_PIXELS) + V_OFFSET_PIXELS);

		screen_srcs_name[i] = lv_label_create(screen_srcs);
		lv_label_set_recolor(screen_srcs_name[i], true);
		lv_obj_align(screen_srcs_name[i], LV_ALIGN_TOP_LEFT, 0,
			     (i * V_OFFSET_PIXELS) + V_OFFSET_PIXELS);

		lv_obj_add_style(screen_srcs_name[i], &style_common, 0);
		lv_label_set_text(screen_srcs_name[i], "-");

		screen_srcs_since_seen[i] = lv_label_create(screen_srcs);
		lv_label_set_recolor(screen_srcs_since_seen[i], true);
		lv_obj_align(screen_srcs_since_seen[i], LV_ALIGN_TOP_RIGHT, 0,
			     (i * V_OFFSET_PIXELS) + V_OFFSET_PIXELS);
		lv_obj_add_style(screen_srcs_since_seen[i], &style_common, 0);
		lv_label_set_text(screen_srcs_since_seen[i], "-");

		screen_snks_since_seen[i] = lv_label_create(screen_snks);
		lv_label_set_recolor(screen_snks_since_seen[i], true);
		lv_obj_align(screen_snks_since_seen[i], LV_ALIGN_TOP_RIGHT, 0,
			     (i * V_OFFSET_PIXELS) + V_OFFSET_PIXELS);
		lv_obj_add_style(screen_snks_since_seen[i], &style_common, 0);
		lv_label_set_text(screen_snks_since_seen[i], "-");
	}

	screen_snks_status_label = lv_label_create(screen_snks);
	lv_obj_set_size(screen_snks_status_label, 250, V_OFFSET_PIXELS);
	lv_obj_align(screen_snks_status_label, LV_ALIGN_TOP_LEFT, 3, 0);
	lv_obj_set_style_text_font(screen_snks_status_label, &lv_font_montserrat_24,
				   LV_PART_MAIN | LV_STATE_DEFAULT);
	lv_obj_set_style_text_align(screen_snks_status_label, LV_TEXT_ALIGN_CENTER,
				    LV_PART_MAIN | LV_STATE_DEFAULT);
	lv_obj_set_style_text_color(screen_snks_status_label, lv_color_black(),
				    LV_PART_MAIN | LV_STATE_DEFAULT);
	lv_obj_set_style_bg_opa(screen_snks_status_label, LV_OPA_TRANSP,
				LV_PART_MAIN | LV_STATE_DEFAULT);
	lv_obj_move_foreground(screen_snks_status_label);
	lv_label_set_text(screen_snks_status_label, "Idle");
	lv_obj_invalidate(screen_snks_status_label);

	screen_srcs_status_label = lv_label_create(screen_srcs);
	lv_obj_set_size(screen_srcs_status_label, 250, V_OFFSET_PIXELS);
	lv_obj_align(screen_srcs_status_label, LV_ALIGN_TOP_LEFT, 3, 0);
	lv_obj_set_style_text_font(screen_srcs_status_label, &lv_font_montserrat_24,
				   LV_PART_MAIN | LV_STATE_DEFAULT);
	lv_obj_set_style_text_align(screen_srcs_status_label, LV_TEXT_ALIGN_CENTER,
				    LV_PART_MAIN | LV_STATE_DEFAULT);
	lv_obj_set_style_text_color(screen_srcs_status_label, lv_color_black(),
				    LV_PART_MAIN | LV_STATE_DEFAULT);
	lv_obj_set_style_bg_opa(screen_srcs_status_label, LV_OPA_TRANSP,
				LV_PART_MAIN | LV_STATE_DEFAULT);
	lv_obj_move_foreground(screen_srcs_status_label);
	lv_label_set_text(screen_srcs_status_label, "Idle");

	screen_all_status_label = screen_snks_status_label;

	lv_obj_move_foreground(screen_snks_status_label);

	/* Force a full initial draw so static widgets are visible before any touch input. */

	sinks_screen_set();

	lvgl_unlock();
	k_timer_start(&gui_update_timer, K_MSEC(100), K_MSEC(100));

	LOG_INF("Display initialized");

	return 0;
}
```

## src/display.h
```c
/*
 * Copyright (c) 2024-2026 Nordic Semiconductor ASA
 *
 * SPDX-License-Identifier: Apache-2.0
 */

#ifndef DISPLAY_H_
#define DISPLAY_H_

#include <stdint.h>
#include <zephyr/sys/slist.h>
#include "sr_info.h"

#define NAME_SIZE_MAX 30

struct display_callbacks {
	void (*snk_selected)(struct brcast_snk_info *snk_info);
	void (*src_selected)(struct brcast_src_info *src_info);
};

void display_state_set(enum ba_states new_state);

int display_scan_result_snk_submit(struct brcast_snk_info snk_info);

int display_scan_result_src_submit(struct brcast_src_info src_info);

/**
 * @brief Initialize the ILI9341 display with LVGL

 * @param callbacks Optional display button callbacks
 *
 * @return 0 on success, negative error code on failure
 */
int display_init(const struct display_callbacks *callbacks);


#endif /* DISPLAY_H_ */
```

## src/sr_info.h
```c
#ifndef __SR_INFO_H__
#define __SR_INFO_H__

#include <zephyr/bluetooth/addr.h>

/* Struct to collect information from scanning
 * for Broadcast Source or Sink
 */
#define NAME_LEN 30

struct brcast_snk_info {
	void *fifo_reserved;
	sys_snode_t node;
	char name[NAME_LEN];
	bt_addr_le_t addr;
	uint64_t last_seen;
	bool update;
};

struct brcast_src_info {
	void *fifo_reserved;
	sys_snode_t node;
	char name[NAME_LEN];
	uint32_t broadcast_id;
	bt_addr_le_t addr;
	uint8_t sid;
	uint16_t pa_interval;
	uint64_t last_seen;
	bool update;
};

enum ba_states {
	STATE_ERROR,
	STATE_IDLE,
	STATE_SCANNING_FOR_SINK,
	STATE_CONNECTING_TO_SINK,
	STATE_CONNECTED_TO_SINK,
	STATE_SETTING_SECURITY,
	STATE_SECURITY_CHANGED,
	STATE_DISCOVERY_DONE,
	STATE_SCANNING_FOR_SOURCE,
	STATE_PER_ADV_SYNC_CREATE,
	STATE_PER_ADV_SYNC_CREATED,
	STATE_ADDING_SOURCE,
	STATE_ADDED_SOURCE,
	STATE_STEPS_MAX,
};

#endif
```
